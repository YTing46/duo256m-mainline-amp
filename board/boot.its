## board/boot.its
```
/dts-v1/;

/ {
	description = "SG2002 Milk-V Duo256M - mainline linux 7.0 (kernel + FDT)";
	#address-cells = <2>;

	images {
		kernel-1 {
			description = "mainline 7.0 kernel";
			data = /incbin/("./Image.lzma");
			type = "kernel";
			arch = "riscv";
			os = "linux";
			compression = "lzma";
			/*
			 * Vendor bootcmd loads the FIT blob at 0x81800000. The
			 * mainline Image decompresses to ~27.5MB, so loading at
			 * the vendor 0x80200000 overwrites the FIT and u-boot
			 * aborts ("new format image overwritten") into a reset
			 * loop. Load above the FIT instead.
			 */
			load = <0x0 0x82000000>;
			entry = <0x0 0x82000000>;
			hash-2 {
				algo = "crc32";
			};
		};

		fdt-sg2002_milkv_duo256m_musl_riscv64_sd {
			description = "cvitek device tree - sg2002_milkv_duo256m_musl_riscv64_sd";
			data = /incbin/("./sg2002-milkv-duo256m.dtb");
			type = "flat_dt";
			arch = "riscv";
			compression = "none";
			hash-1 {
				algo = "sha256";
			};
		};
	};

	configurations {
		default = "config-sg2002_milkv_duo256m_musl_riscv64_sd";

		config-sg2002_milkv_duo256m_musl_riscv64_sd {
			description = "boot cvitek system with board sg2002_milkv_duo256m_musl_riscv64_sd";
			kernel = "kernel-1";
			fdt = "fdt-sg2002_milkv_duo256m_musl_riscv64_sd";
		};
	};
};
```
